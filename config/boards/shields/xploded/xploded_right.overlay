/*
 * Copyright (c) 2020 Pete Johanson, Kurtis Lew
 *
 * SPDX-License-Identifier: MIT
 */

#include "xploded.dtsi"

&default_transform { // Offset of 6 because the left side has 6 columns
    col-offset = <6>;
};