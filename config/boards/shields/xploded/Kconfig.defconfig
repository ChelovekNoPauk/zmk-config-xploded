## config/boards/shields/xploded/Kconfig.defconfig
```kconfig
# Copyright (c) 2020 Pete Johanson, Kurtis Lew
# SPDX-License-Identifier: MIT

if SHIELD_XPLODED_LEFT

config ZMK_KEYBOARD_NAME
    default "Xploded board"

config ZMK_SPLIT_ROLE_CENTRAL
    default y

endif

if SHIELD_XPLODED_LEFT || SHIELD_XPLODED_RIGHT

config ZMK_SPLIT
    default y

endif
```

## config/boards/shields/xploded/Kconfig.shield
```kconfig
# Copyright (c) 2020 Pete Johanson, Kurtis Lew
# SPDX-License-Identifier: MIT

config SHIELD_XPLODED_LEFT
    def_bool $(shields_list_contains,xploded_left)

config SHIELD_XPLODED_RIGHT
    def_bool $(shields_list_contains,xploded_right)
```
